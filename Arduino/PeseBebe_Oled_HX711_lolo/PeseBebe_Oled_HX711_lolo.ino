#include <HX711.h>
#include <U8glib.h>


// Defining the pins for the weight sensor 
  #define DOUT 6
  #define CLK 5
  HX711 scale(DOUT, CLK); //  /!\ Careful! This syntax only works with the library 'HX711-master'
  
// Configuration of the 
U8GLIB_SSD1306_128X64 u8g(U8G_I2C_OPT_DEV_0|U8G_I2C_OPT_NO_ACK|U8G_I2C_OPT_FAST);  // Fast I2C / TWI 
//U8GLIB_SSD1306_128X64 u8g(U8G_I2C_OPT_NONE|U8G_I2C_OPT_DEV_0);  // I2C / TWI 
//U8GLIB_SSD1306_128X64 u8g(10, 9);    // HW SPI Com: CS = 10, A0 = 9 (Hardware Pins are  SCK = 13 and MOSI = 11)
void u8g_prepare(void) {
  u8g.setFont(u8g_font_6x10);
  // u8g.setFont(u8g_font_9x18);
  // u8g.setFont(u8g_font_osb18);
  
  u8g.setFontRefHeightExtendedText();
  u8g.setDefaultForegroundColor();
  u8g.setFontPosTop();
}

uint8_t draw_state = 0;

void paragraph(void) {
  u8g_prepare();

  String messageMat[10];
  messageMat[0] = "Humanity";
  messageMat[1] = "Lab";
  
  char charBuf[50];

  for (int i=0; i<=2; i++){
    String subStringNow = messageMat[i];
    subStringNow = subStringNow.substring(0,draw_state);
    Serial.println("Oth:"+subStringNow);
             
    subStringNow.toCharArray(charBuf, 50) ;
    
    u8g.drawStr( 0, 0+25*i, charBuf);
  }
}

void babyFace(void){

#define u8g_logo_width 128
#define u8g_logo_height 64
//static unsigned char u8g_logo_bits[] = {
static unsigned char u8g_logo_bits[] U8G_PROGMEM = {
  0x00, 0x00, 0x00, 0x00, 0x00, 0x00, 0x00, 0x00, 0x00, 0x00, 0x00, 0x00, 
  0x00, 0x00, 0x00, 0x00, 0x00, 0x00, 0x00, 0x00, 0x00, 0x00, 0x00, 0x00, 
  0x00, 0x00, 0x00, 0x00, 0x00, 0x00, 0x00, 0x00, 0x00, 0x00, 0x00, 0x00, 
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  0x00, 0x00, 0x00, 0x00, };

  u8g.firstPage();  
  do {
     u8g.drawXBMP( 0, 0, u8g_logo_width, u8g_logo_height, u8g_logo_bits);
  } while( u8g.nextPage() );

// Let us see that baby face ! :)
delay(4000);
  
}



void initialMessage(void) {

   // Display characteristics
   u8g.setFont(u8g_font_9x18);
   u8g.setFontPosTop();

  // Set up of the message
  String message = "Baby ScaleHumanity Lab :)";
  int LINE_SPACE=20;
  
  int nChar = message.length();
  Serial.println("Size of the message =>" + String(nChar));

  
  // -------------------------------- // 
  //      Dividing the message...     //
  // -------------------------------- //
      int nLines = 0;
      int lastBreak = 0;
      String lines[10];
      
      char charBuffer[50];
      
      for (int ii=0; ii<(nChar-1); ii++){
        // Serial.println(String(ii));
        String currentString = message.substring(lastBreak, ii+2);
        currentString.toCharArray(charBuffer, 50);
        
        // Serial.println("Length of the word: "+String(u8g.getStrWidth(charBuf)));
         
        if ((u8g.getStrWidth(charBuffer) > u8g.getWidth())){
          lines[nLines] = message.substring(lastBreak, ii+1);
          Serial.println(String(nLines)+": "+String(lines[nLines]));
          nLines++;
          lastBreak = ii+1;
           }
          if (ii==(nChar-2)){
           lines[nLines] = message.substring(lastBreak, ii+2);
           Serial.println(String(nLines)+"=> "+String(lines[nLines]));
           nLines++;
           lastBreak = ii+1;
           
          }
      }
      
  // -------------------------------- //
  // -------------------------------- //


  // -------------------------------- // 
  //      Displaying the message      //
  // -------------------------------- //
  
  int topLines[nLines]= {0};
  int currentLine = 0; int sum =0;
  char charBuf[50];
  topLines[0]=1;
  
  message.toCharArray(charBuf, 3) ;
  Serial.println(charBuf);
   
  for (int jj = 0; jj< nChar; jj++){
      // Set up the display
      u8g.firstPage();
      do{
          for (int ii = 0; ii<nLines; ii++){
  
              // Display loop
                String stringAux = lines[ii];
                Serial.println("String is: "+stringAux);

                if(ii<=currentLine){ sum =1;} else { sum =0;}
                stringAux = stringAux.substring(0, topLines[ii]) ; //min(max(((jj-l*ii)+1),0),l)
                
                stringAux.toCharArray(charBuf, 50) ;
                Serial.println("Now is: "+ String(charBuf));
                
                u8g.drawStr( 0, 5+LINE_SPACE*ii, charBuf);
                
  
          }
      }while(u8g.nextPage()); 
  
     
      if (topLines[currentLine] <  lines[currentLine].length() ){
        topLines[currentLine]++;
      }
      else{
        currentLine++;
        topLines[currentLine]++;
      }
      Serial.println("tops: "+ String(jj));
      for (int ii = 0; ii<nLines; ii++){
        Serial.println(String(topLines[ii]));
      }
      Serial.println(" ");            
      delay(10);
  }

// -------------------------------- //
// -------------------------------- //
  
  // Pause to see the message...
  delay(5000);
}


void menu(void) {

   // Display characteristics
   // u8g.setFont(u8g_font_9x18);
   u8g.setFont(u8g_font_osb18);
   
   u8g.setFontPosTop();
   
  // Set up the display
  u8g.firstPage();

  // Display loop
    do {
      Serial.println("Menu");
      u8g.drawStr( 20, 15, "0000 g");
    } while(u8g.nextPage()); 
      
}




void setup(void) {

  // lolo: pour le capteur de poids seulement
  Serial.begin(38400);
  Serial.println("peseBebe v1");
  Serial.println("Initializing the scale");
  // parameter "gain" is ommited; the default value 128 is used by the library
  // HX711.DOUT  - pin #D6
  // HX711.PD_SCK - pin #D5
  scale.begin(DOUT, CLK);
  scale.set_scale(211);  // lolo: mesure obtenue avec le sketch CalibrageHX711Spartfunk56.ino
  scale.tare();                // reset the scale to 0
  long tareNB = scale.read_average(100);
  
  float valEnGramme =0 ;
  // lolo: fin section capteur de poids. 
  // flip screen, if required
  //u8g.setRot180();
  u8g.setFont(u8g_font_6x10);
  // u8g.setFont(u8g_font_9x18);
  // u8g.setFont(u8g_font_osb18);
  
  u8g.setFontRefHeightExtendedText();
  u8g.setDefaultForegroundColor();
  u8g.setFontPosTop();
  

  
#if defined(ARDUINO)
  pinMode(13, OUTPUT);           
  digitalWrite(13, HIGH);  
#endif

}

void AIRBUS(void){
 // Set up the display
  u8g.firstPage();
  
  u8g.setFont(u8g_font_osb18);
  do {      
      Serial.println("[Nothing]");
      u8g.drawStr( 15, 35, "AIRBUS");
    } while(u8g.nextPage()); 
            
   delay(1000);
}

void HumanityLab(void){
 // Set up the display
  u8g.firstPage();
  
  u8g.setFont(u8g_font_osb18);
  // Display loop
   do {      
      Serial.println("[Nothing]");
      u8g.drawStr( 15, 25, "Humanity");
      u8g.drawStr( 45, 45, "Lab");
    } while(u8g.nextPage()); 

  delay(1000);

}


int state = 0;

void loop(void) {
  
  Serial.println("State: "+String(state));
  int income;
  long valLue;
  
  //u8g_prepare();
  switch (state) {
    case 0:  AIRBUS();
             state++;
    break;
    case 1:
            //initialMessage();
            HumanityLab();
            state++;
    break;
    
    case 2:
            babyFace();
            state++;
    break;
    case 3:                
            //lolo: pesee et affichage sur OLED
            // Display characteristics
            // u8g.setFont(u8g_font_9x18);
            u8g.setFont(u8g_font_osb18); 
            u8g.setFontPosTop();
            // Set up the display
            u8g.firstPage();
            // Display loop
            float valLue = scale.get_units(30);
//              long valLue = scale.get_value(5);
//              long valLue = scale.read();

            do {
                u8g.setPrintPos(20, 15) ;
                u8g.print(valLue, 1);
                u8g.setPrintPos(15, 35) ;
                u8g.print("grammes");
            } while(u8g.nextPage());
    break;
    
    default:
  
    break;
  } 
      
}
