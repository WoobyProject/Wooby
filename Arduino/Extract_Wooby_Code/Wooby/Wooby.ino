#include "U8glib.h"
#include "HX711.h"
#include <avr/sleep.h>

//***********************//
//*     SENSOR CONF    *//
//***********************//

  #define DOUT 6
  #define CLK 5
  #define MODEL 3

  HX711 scale(DOUT, CLK);
  int nMeasures = 10;
  int nMeasuresTare = 30;
  
  // Model choice
  #if MODEL == 1 
    float calibration_factor=41.9541;
  #endif

  #if MODEL == 2  
    float calibration_factor=-42.5012;
  #endif

  #if MODEL == 3  
    float calibration_factor=-61.7977;
  #endif
  
  int gain = 64;  // Reading values with 64 bits (could be 128 too)

  float MAX_GR_VALUE = 10000;

  float correctedValueFiltered = 0;
  float displayFinalValue = 0;
  float displayFinalValue_1 = 0;
  
//***********************//
//*     DISPLAY CONF    *//
//***********************//

  //lolo: lib la plus rapide
  U8GLIB_SSD1306_128X64 u8g(U8G_I2C_OPT_DEV_0|U8G_I2C_OPT_NO_ACK|U8G_I2C_OPT_FAST);  // Fast I2C / TWI 
  
  //U8GLIB_SSD1306_128X64 u8g(U8G_I2C_OPT_NONE|U8G_I2C_OPT_DEV_0);  // I2C / TWI 
  //U8GLIB_SSD1306_128X64 u8g(10, 9);    // HW SPI Com: CS = 10, A0 = 9 (Hardware Pins are  SCK = 13 and MOSI = 11)
  int state = 0;

  #define u8g_logo_width 128
  #define u8g_logo_height 64


//***********************//
//*      INACTIVITY     *//
//***********************//

  const float MAX_INACTIVITY_TIME = 30000; // in milliseconds 
  const float INACTIVE_THR  = 5.0;
  bool bInactive = false;
  unsigned long lastTimeActivity = 0;
  const byte interruptPin = 2;



       // 'Wooby logo', 128x64px
    static unsigned char logoWooby [] U8G_PROGMEM = {
        0x00, 0x00, 0x00, 0x00, 0x00, 0x00, 0x00, 0x00, 0x00, 0x00, 0x00, 0x00, 
        0x00, 0x00, 0x00, 0x00, 0x00, 0x00, 0x00, 0x00, 0x00, 0x00, 0x00, 0x00, 
        0x00, 0x00, 0x00, 0x00, 0x00, 0x00, 0x00, 0x00, 0x00, 0x00, 0x00, 0x00, 
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        0x00, 0x00, 0x00, 0x00, };


    // 'Waiting display', 128x64px
    static unsigned char waitingDisplay [] U8G_PROGMEM = {
      0xff, 0xff, 0xff, 0xff, 0xff, 0xff, 0xff, 0xff, 0xff, 0xff, 0xff, 0xff, 0xff, 0xff, 0xff, 0xff, 
      0xff, 0xff, 0xff, 0xff, 0xff, 0xff, 0xff, 0xff, 0xff, 0xff, 0xff, 0xff, 0xff, 0xff, 0xff, 0xff, 
      0xff, 0xff, 0xff, 0xff, 0xff, 0xff, 0xff, 0xff, 0xff, 0xff, 0xff, 0xff, 0xff, 0xff, 0xff, 0xff, 
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      0xff, 0xff, 0xff, 0xff, 0xff, 0xff, 0xff, 0xff, 0xff, 0xff, 0xff, 0xff, 0xff, 0xff, 0xff, 0xff
    };
    // 'Powered by display', 128x64px
    const unsigned char poweredByDisplayArray [] PROGMEM = {
      0xff, 0xff, 0xff, 0xff, 0xff, 0xff, 0xff, 0xff, 0xff, 0xff, 0xff, 0xff, 0xff, 0xff, 0xff, 0xff, 
      0xff, 0xff, 0xff, 0xff, 0xff, 0xff, 0xff, 0xff, 0xff, 0xff, 0xff, 0xff, 0xff, 0xff, 0xff, 0xff, 
      0xff, 0xff, 0xff, 0xff, 0xff, 0xff, 0xff, 0xff, 0xff, 0xff, 0xff, 0xff, 0xff, 0xff, 0xff, 0xff, 
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      0xff, 0xff, 0xff, 0xff, 0xff, 0xff, 0xff, 0xff, 0xff, 0xff, 0xff, 0xff, 0xff, 0xff, 0xff, 0xff
    };
    // 'Baby face', 128x64px
    const unsigned char babyFace [] PROGMEM = {
      0xff, 0xff, 0xff, 0xff, 0xff, 0xff, 0xff, 0xff, 0xff, 0xff, 0xff, 0xff, 0xff, 0xff, 0xff, 0xff, 
      0xff, 0xff, 0xff, 0xff, 0xff, 0xff, 0xff, 0xff, 0xff, 0xff, 0xff, 0xff, 0xff, 0xff, 0xff, 0xff, 
      0xff, 0xff, 0xff, 0xff, 0xff, 0xff, 0xff, 0xff, 0xff, 0xff, 0xff, 0xff, 0xff, 0xff, 0xff, 0xff, 
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      0xff, 0xff, 0xff, 0xff, 0xff, 0xff, 0xff, 0xff, 0xff, 0xff, 0xff, 0xff, 0xff, 0xff, 0xff, 0xff
    };

    static unsigned char u8g_logo_bits[] U8G_PROGMEM = {
      0x00, 0x00, 0x00, 0x00, 0x00, 0x00, 0x00, 0x00, 0x00, 0x00, 0x00, 0x00, 
      0x00, 0x00, 0x00, 0x00, 0x00, 0x00, 0x00, 0x00, 0x00, 0x00, 0x00, 0x00, 
      0x00, 0x00, 0x00, 0x00, 0x00, 0x00, 0x00, 0x00, 0x00, 0x00, 0x00, 0x00, 
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      0x00, 0x00, 0x00, 0x00, };
      
//***********************//
//*      FILTERING      *//
//***********************//
    // Filter
    
    struct filterResult {
      float yk;
      int   bSync;
    };
    
    filterResult realValueFilterResult;

    float realValue;
    float realValue_1;
    float realValueFiltered;
    float realValueFiltered_1;
    int  bSync;
    
    float yk_1 = 0;
    float uk_1 = 0;
    float yk = 0;
    
    float yk_1_corr = 0;
    float uk_1_corr = 0;
    float yk_corr = 0;

   
    // int   bSync = 0;
    int   bSync_corr = 0;



    
//***********************//
//*      FUNCTIONS      *//
//***********************//

//***********************//
//*  DISPLAY FUNCTIONS  *//
//***********************//

  void displayImage( unsigned char u8g_image_bits){
      
     u8g.firstPage();  
     do {
         u8g.drawXBMP( 0, 0, u8g_logo_width, u8g_logo_height, u8g_image_bits);
     } while( u8g.nextPage() );
    
     // Let us see that baby face ! :)
     delay(4000);
  }

void logoWoobyDisplay (void){


       // 'Wooby logo', 128x64px
    static unsigned char logoWooby2 [] U8G_PROGMEM = {
        0x00, 0x00, 0x00, 0x00, 0x00, 0x00, 0x00, 0x00, 0x00, 0x00, 0x00, 0x00, 
        0x00, 0x00, 0x00, 0x00, 0x00, 0x00, 0x00, 0x00, 0x00, 0x00, 0x00, 0x00, 
        0x00, 0x00, 0x00, 0x00, 0x00, 0x00, 0x00, 0x00, 0x00, 0x00, 0x00, 0x00, 
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        0x00, 0x00, 0x00, 0x00, };

     u8g.firstPage();  
     do {
         u8g.drawXBMP( 0, 0, u8g_logo_width, u8g_logo_height, logoWooby2);
     } while( u8g.nextPage() );
    
     // Let us see our logo !
     delay(4000);

}


 void poweredByDisplay(void){
    Serial.println("");
    Serial.println("Displaying Powered by ...");
   
   // Set up the display
    u8g.firstPage();
    u8g.setFont(u8g_font_osb18);
    
    do {
        u8g.setFont(u8g_font_6x10);
        u8g.drawStr( 30, 15, "Powered by");
        u8g.setFont(u8g_font_osb18);
        u8g.drawStr( 10, 40, "Humanity");
        u8g.setFont(u8g_font_osb18);
        u8g.drawStr( 40, 60, "Lab");
    }while(u8g.nextPage()); 

    Serial.println("Waiting 1 sec...");
    delay(1000);
    Serial.println("");
  }

  void sponsorsDisplay(void){
    Serial.println("");
    Serial.println("Displaying Sponsors.."); 
    
    // Set up the display
      u8g.firstPage();
      u8g.setFont(u8g_font_osb18);
    
    // Display loop
     do {
        u8g.setFont(u8g_font_osb18);
        u8g.drawStr( 15, 25, "AIRBUS");
        
        u8g.setFont(u8g_font_6x10);
        u8g.drawStr( 60, 35, "&");
        
        u8g.setFont(u8g_font_osb18);
        u8g.drawStr( 15, 55, "MEDAIR");
     }while(u8g.nextPage()); 
     
    Serial.println("Waiting 1 sec...");
    delay(1000);
    Serial.println("");
  
  }


//*******************************//
//*      WEIGHTING ALGORITHM    *//
//*******************************//

    float correctionAlgo(float realValue){
      
      int realValueInt = int(realValue);
      float realValueDecim = (realValue - float(realValueInt)) ;
      float correctedValue;

      // Zero  and negative values deletion //
        if (realValue< 5.0){
          return correctedValue = 0.0;
        }
       
      // Round algorithm //
        if ( realValueDecim < 0.4) { correctedValue = long(realValueInt);}
        if ( realValueDecim >= 0.4 && realValueDecim <= 0.7) { correctedValue = long(realValueInt)+0.5 ; }
        if ( realValueDecim > 0.7) { correctedValue = long(realValueInt)+1; }
    
      return correctedValue;
    }
    
    filterResult filtering(float uk, float uk_1, float yk_1){
       float a =  0.3915;
       float b = 0.6085;
        
      filterResult myResult;
      if (abs(uk-uk_1) < 5) {
        // Filtering 
        myResult.yk = a*uk_1 + b*yk_1;
        myResult.bSync = 0;
        }
      else{
        // Syncing 
        myResult.yk = uk;
        myResult.bSync = 1;
      }
      
      return myResult;
    }


//***************************//
//*       INACTIVITY        *//
//***************************//

void inactivityCheck () {

  // Checking activity
    if (abs(displayFinalValue - displayFinalValue_1 ) > INACTIVE_THR ){
          Serial.print("Active: ");Serial.print(bInactive);
          lastTimeActivity =  millis();
          if (bInactive){
            // Waking the Arduino up
             
             
            // Waking the screen up
            u8g.sleepOff();
            bInactive =  false;
            }
    }

  // Checking inactivity 
    if ((millis() - lastTimeActivity) > MAX_INACTIVITY_TIME){
          Serial.println("Inactive");
          bInactive = true;

          // Putting the screen in sleep mode
          u8g.sleepOn();

          // Putting the Arduino in sleep mode
          /*set_sleep_mode(SLEEP_MODE_PWR_DOWN);
          sleep_enable();
          sleep_cpu();*/
    }

  /*
                
                if (inactivityCounter > MAX_INACTIVITY_TIME){
                  u8g.sleepOn();
                }

                if (timeAfterAlgo> 25000){
                 
                }
                */
                
}

void wakeUp (void){
  bInactive = false;
  lastTimeActivity =  millis();
    u8g.sleepOff();
}

    
//***********************//
//*       SET UP        *//
//***********************//

void setup(void) {

  Serial.begin(9600);
  Serial.println("peseBebe v1");
  Serial.println("Initializing the scale");
  
  
  //*       SET UP  WEIGHT SENSOR       *//
  
    scale.begin(DOUT, CLK);
    scale.set_gain(gain);
    scale.set_scale(calibration_factor); 
      
  //*            AUTO TARE             *//  
  
    double tareWU = scale.tare(nMeasuresTare);                // reset the scale to 0
    // long tareNB = scale.read_average(100);
    float tareGR = tareWU/scale.get_scale();
    
    Serial.print("Balance taree a (wu):"); Serial.println(tareWU);
    Serial.print("Balance taree a (gr):"); Serial.println(tareGR);
    Serial.print("CLOCK DIVISION:"); Serial.println(CLKPR);

    
    float valEnGramme = 0 ;


  //*            FILTERING            *//  
    
    realValue_1 = 0;
    realValueFiltered = 0;
    realValueFiltered_1 = 0;
    bSync = false;
    
    float yk_1 = 0;
    float uk_1 = 0;
    float yk = 0;
    
  //*          SCREEN SETUP          *//  
      // Flip screen, if required
        u8g.setRot180();
        
      // Set up of the font
        u8g.setFont(u8g_font_6x10);
        // u8g.setFont(u8g_font_9x18);
        // u8g.setFont(u8g_font_osb18);
        
     // Other display set-ups
        u8g.setFontRefHeightExtendedText();
        u8g.setDefaultForegroundColor();
        u8g.setFontPosTop();

  //*          INACTIVITY          *//         
    lastTimeActivity =  millis();
    pinMode(interruptPin, INPUT_PULLUP);
    attachInterrupt(digitalPinToInterrupt(interruptPin), wakeUp, CHANGE);
    
  #if defined(ARDUINO)
    pinMode(13, OUTPUT);           
    digitalWrite(13, HIGH);  
  #endif

}

//***********************//
//*        LOOP         *//
//***********************//
  char data[100];
  unsigned long timeAfterAlgo;
  
  void loop(void) {
    
  //  Serial.println("State: " + String(state));
  
    
    unsigned long beforeMeasure = 0;
    unsigned long afterMeasure = 0;
       
    long tareWU;
    float tareGR;
    


    //********************************//
    //*  READING OF SERIAL ENTRIES   *//
    //********************************//
      if(Serial.available())
      {
        char temp = Serial.read();
        switch(temp){
        case '+': calibration_factor += 1;
                  scale.set_scale(calibration_factor);
                  break;
        case '-': calibration_factor -= 1;
                  scale.set_scale(calibration_factor);
                  break;
        case 'a': calibration_factor += 0.1;
                  scale.set_scale(calibration_factor);
                  break;
        case 'z': calibration_factor -= 0.1;
                  scale.set_scale(calibration_factor);
                  break;
        case 't': tareWU = scale.tare(nMeasuresTare); 
                  tareGR = tareWU/scale.get_scale();
                  Serial.print("Balance taree a (wu):"); Serial.println(tareWU);
                  Serial.print("Balance taree a (gr):"); Serial.println(tareGR);
    
                  break;
        default:
                  break;
        }
                  
      }
      
  
    //u8g_prepare();
    switch (state) {
      case 0:  poweredByDisplay();
               state++;
      break;
      case 1:
              //initialMessage();
              sponsorsDisplay();
              state++;
      break;
      
      case 2:
              // displayImage(logoWooby);
              logoWoobyDisplay();
              state++;
              
              // Displaying and weighting is about to begin
              Serial.println("DATA START");
      break;
      case 3:                
             
              
              // Display characteristics
                // u8g.setFont(u8g_font_9x18);
                u8g.setFont(u8g_font_osb18); 
                u8g.setFontPosTop();
              // Set up the display
                u8g.firstPage();
                
              // Display loop

              // Weighting //
                beforeMeasure = millis();
                float realValue_WU = scale.read_average(nMeasures);
                float realValue = (realValue_WU-scale.get_offset())/scale.get_scale() ;  // same as scale.get_units(nMeasures)
                afterMeasure = millis();
                
                float correctedValue = correctionAlgo(realValue);

                
              // Filtering  //
              
                // Filtering for the real value //
                  realValueFilterResult = filtering(realValue, realValue_1, realValueFiltered_1);
                  bSync = realValueFilterResult.bSync;
                  realValueFiltered = realValueFilterResult.yk;
                  
                // Updating 
                  realValueFiltered_1 = realValueFiltered;
                  realValue_1 = realValue;

                correctedValueFiltered = correctionAlgo(realValueFiltered);
                
                /*  if (abs(uk_1-realvalLue) < 5) {
                    yk = a*uk_1 + b*yk_1;
                    bSync = 0;
                    }
                  else{
                    yk = realvalLue;
                    bSync = 1;
                  }
                  
                // Filtering for the corrected value //
                  if (abs(uk_1-correctedValue) < 5) {
                    yk_corr = a*uk_1_corr + b*yk_1_corr;
                    bSync_corr = 0;
                    }
                  else{
                    yk_corr = correctedValue;
                    bSync_corr = 1;
                  }
                */ 

                // Serial monitor outputs  //
                timeAfterAlgo = millis();

                Serial.print(timeAfterAlgo);                  Serial.print(",\t");
                Serial.print(realValue, 4);                   Serial.print(",\t");
                Serial.print(correctedValue, 4);              Serial.print(",\t");
                Serial.print(beforeMeasure);                  Serial.print(",\t");
                Serial.print(afterMeasure);                   Serial.print(",\t");
                Serial.print(realValueFiltered, 4);           Serial.print(",\t");
                Serial.print(correctedValueFiltered, 4);      Serial.print(",\t");
                Serial.print(bSync);                          Serial.print(",\t");
                Serial.print(bSync_corr);                     Serial.print(",\t");
                Serial.print(calibration_factor,4);           Serial.print(",\t");
                //Serial.print(valLue_WU/realvalLue,4);Serial.print(",\t");
                Serial.print((float)scale.get_offset(), 4);   Serial.print(",\t");
                Serial.print(realValue_WU);                   Serial.print(",\t");
                Serial.print(bInactive);                      Serial.print(",\t");
                Serial.print(lastTimeActivity);               Serial.print(",\t");
                Serial.println("");
                //Serial.print("Activation pin state: "); Serial.println(digitalRead(5));

                displayFinalValue_1 = displayFinalValue;
                displayFinalValue = correctedValueFiltered;
                
              //     Displaying     //
                  if (correctedValueFiltered > MAX_GR_VALUE) {
                      do {
                            
                            u8g.setPrintPos(15, 15) ;
                            u8g.print(" OVER");
                            u8g.setPrintPos(15, 40) ;
                            u8g.print("FLOW !");
                        } while(u8g.nextPage());  
                              
                      }
                  else{
                    do {
                        u8g.setPrintPos(15, 15) ;
                        u8g.print(int(displayFinalValue_1), 1);
                        u8g.setPrintPos(15, 35);
                        u8g.print("grams");
                    } while(u8g.nextPage());
                  }

              inactivityCheck();
              if (bInactive){
                Serial.println("Display set to inactive");
              }
              

      break;
      
      default:
      break;
    } 
        
  }
