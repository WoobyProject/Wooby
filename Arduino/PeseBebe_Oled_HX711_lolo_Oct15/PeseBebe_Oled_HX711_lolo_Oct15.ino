#include "U8glib.h"
#include "HX711.h"

//***********************//
//*     SENSOR CONF    *//
//***********************//

  #define DOUT 6
  #define CLK 5

  HX711 scale(DOUT, CLK);
  int nMeasures = 10;
  // For the first protoype
  float calibration_factor=41.9541;
  // at   0 gr => 41.10;
  // at 500 gr => 40.40;
  // from polyfit Matlab =>  41.3541

  // For the second protoype
  // float calibration_factor=42.5;
  
  int gain = 64;  //lolo: test avec un codage des valeurs lues en 64bits au lieu de 128 bits.
  
//***********************//
//*     DISPLAY CONF    *//
//***********************//

  //lolo: lib la plus rapide
  U8GLIB_SSD1306_128X64 u8g(U8G_I2C_OPT_DEV_0|U8G_I2C_OPT_NO_ACK|U8G_I2C_OPT_FAST);  // Fast I2C / TWI 
  
  //U8GLIB_SSD1306_128X64 u8g(U8G_I2C_OPT_NONE|U8G_I2C_OPT_DEV_0);  // I2C / TWI 
  //U8GLIB_SSD1306_128X64 u8g(10, 9);    // HW SPI Com: CS = 10, A0 = 9 (Hardware Pins are  SCK = 13 and MOSI = 11)
  int state = 0;

//***********************//
//*      FILTERING      *//
//***********************//
    // Filter
    float yk_1 = 0;
    float uk_1 = 0;
    float yk = 0;
    
    float yk_1_corr = 0;
    float uk_1_corr = 0;
    float yk_corr = 0;

    
    float a =  0.3915;
    float b = 0.6085;
    int   bSync = 0;
    int   bSync_corr = 0;
    
//***********************//
//*      FUNCTIONS      *//
//***********************//

//***********************//
//*  DISPLAY FUNCTIONS  *//
//***********************//
  void babyFace(void){
  
    #define u8g_logo_width 128
    #define u8g_logo_height 64

    static unsigned char u8g_logo_bits[] U8G_PROGMEM = {
      0x00, 0x00, 0x00, 0x00, 0x00, 0x00, 0x00, 0x00, 0x00, 0x00, 0x00, 0x00, 
      0x00, 0x00, 0x00, 0x00, 0x00, 0x00, 0x00, 0x00, 0x00, 0x00, 0x00, 0x00, 
      0x00, 0x00, 0x00, 0x00, 0x00, 0x00, 0x00, 0x00, 0x00, 0x00, 0x00, 0x00, 
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      0x00, 0x00, 0x00, 0x00, };
    
     u8g.firstPage();  
     do {
         u8g.drawXBMP( 0, 0, u8g_logo_width, u8g_logo_height, u8g_logo_bits);
     } while( u8g.nextPage() );
    
     // Let us see that baby face ! :)
     delay(4000);
  }

 void AIRBUS(void){
    Serial.println("");
    Serial.println("Displaying AIRBUS...");
   
   // Set up the display
    u8g.firstPage();
    u8g.setFont(u8g_font_osb18);
    
    do {
        u8g.drawStr( 15, 35, "AIRBUS");
        u8g.drawStr( 55, 55, "for");
    }while(u8g.nextPage()); 

    Serial.println("Waiting 1 sec...");
    delay(1000);
    Serial.println("");
  }

  void HumanityLab(void){
    Serial.println("");
    Serial.println("Displaying Humanity Lab..."); 
    
    // Set up the display
      u8g.firstPage();
      u8g.setFont(u8g_font_osb18);
    
    // Display loop
     do {
        u8g.drawStr( 15, 25, "Humanity");
        u8g.drawStr( 45, 45, "Lab");
     }while(u8g.nextPage()); 
     
    Serial.println("Waiting 1 sec...");
    delay(1000);
    Serial.println("");
  
  }
  
//***********************//
//*       SET UP        *//
//***********************//

void setup(void) {

  Serial.begin(9600);
  Serial.println("peseBebe v1");
  Serial.println("Initializing the scale");
  
  
  //*       SET UP  WEIGHT SENSOR       *//
  
    scale.begin(DOUT, CLK);
    scale.set_gain(gain);
    scale.set_scale(calibration_factor); 
      
  //*            AUTO TARE             *//  
  
    double tareWU = scale.tare(10);                // reset the scale to 0
    // long tareNB = scale.read_average(100);
    float tareGR = tareWU/scale.get_scale();  
    tareGR = (tareWU+66748)/41.3541; // according to Matlab data
    
    Serial.print("Balance taree a (wu):"); Serial.println(tareWU);
    Serial.print("Balance taree a (gr):"); Serial.println(tareGR);
    
    float valEnGramme = 0 ;


  //*            FILTERING            *//  
    float yk_1 = 0;
    float uk_1 = 0;
    float yk = 0;
    
  //*          SCREEN SETUP          *//  
      // Flip screen, if required
      //u8g.setRot180();
      // Set up of the font
        u8g.setFont(u8g_font_6x10);
        // u8g.setFont(u8g_font_9x18);
        // u8g.setFont(u8g_font_osb18);
     // Other display set-ups
        u8g.setFontRefHeightExtendedText();
        u8g.setDefaultForegroundColor();
        u8g.setFontPosTop();

    
  #if defined(ARDUINO)
    pinMode(13, OUTPUT);           
    digitalWrite(13, HIGH);  
  #endif

}

//***********************//
//*        LOOP         *//
//***********************//
  char data[100];
  unsigned long afterAlgo;
  
  void loop(void) {
    
  //  Serial.println("State: "+String(state));
    int income;
    long valLue;
    int valLueEntier ;
    float valLueDecim ;
    unsigned long beforeMeasure = 0;
    unsigned long afterMeasure = 0;

    long tareWU;
    float tareGR;
    


    //********************************//
    //*  READING OF SERIAL ENTRIES   *//
    //********************************//
      if(Serial.available())
      {
        char temp = Serial.read();
        switch(temp){
        case '+': calibration_factor += 1;
                  scale.set_scale(calibration_factor);
                  break;
        case '-': calibration_factor -= 1;
                  scale.set_scale(calibration_factor);
                  break;
        case 'a': calibration_factor += 0.1;
                  scale.set_scale(calibration_factor);
                  break;
        case 'z': calibration_factor -= 0.1;
                  scale.set_scale(calibration_factor);
                  break;
        case 't': tareWU = scale.tare(10); 
                  tareGR = tareWU/scale.get_scale();
                  tareGR = (tareWU+66748)/41.3541; // according to Matlab data
                  Serial.print("Balance taree a (wu):"); Serial.println(tareWU);
                  Serial.print("Balance taree a (gr):"); Serial.println(tareGR);
    
                  break;
        default:
                  break;
        }
                  
      }
      
  
    //u8g_prepare();
    switch (state) {
      case 0:  AIRBUS();
               state++;
      break;
      case 1:
              //initialMessage();
              HumanityLab();
              state++;
      break;
      
      case 2:
              babyFace();
              state++;
              // Displaying and weighting
              Serial.println("DATA START");
      break;
      case 3:                
              
              // Display characteristics
                // u8g.setFont(u8g_font_9x18);
                u8g.setFont(u8g_font_osb18); 
                u8g.setFontPosTop();
              // Set up the display
                u8g.firstPage();
              // Display loop

              // Weighting //
                beforeMeasure = millis();
                float valLue = scale.get_units(nMeasures);
                afterMeasure = millis();
                
                float realvalLue = valLue;
                float correctedValue = valLue;
                valLueEntier = int(valLue);
                valLueDecim = (valLue - float(valLueEntier)) ;
               
  
              // Round algorithm //
                if ( valLueDecim < 0.4) { correctedValue = long(valLueEntier);}
                if ( valLueDecim >= 0.4 && valLueDecim <= 0.7) { correctedValue = long(valLueEntier)+0.5 ; }
                if ( valLueDecim > 0.7) { correctedValue = long(valLueEntier)+1; }

              // Filtering  //
              
                // Filtering for the real value //
                  if (abs(uk_1-realvalLue) < 5) {
                    yk = a*uk_1 + b*yk_1;
                    bSync = 0;
                    }
                  else{
                    yk = realvalLue;
                    bSync = 1;
                  }
                // Filtering for the corrected value //
                  if (abs(uk_1-correctedValue) < 5) {
                    yk_corr = a*uk_1_corr + b*yk_1_corr;
                    bSync_corr = 0;
                    }
                  else{
                    yk_corr = correctedValue;
                    bSync_corr = 1;
                  }
                
                afterAlgo = millis();

                Serial.print(afterAlgo);          Serial.print(",\t");
                Serial.print(realvalLue);         Serial.print(",\t");
                Serial.print(correctedValue);     Serial.print(",\t");
                Serial.print(beforeMeasure);      Serial.print(",\t");
                Serial.print(afterMeasure);       Serial.print(",\t");
                Serial.print(yk);                 Serial.print(",\t");
                Serial.print(yk_corr);            Serial.print(",\t");
                Serial.print(bSync);              Serial.print(",\t");
                Serial.print(bSync_corr);         Serial.print(",\t");
                Serial.print(calibration_factor); Serial.print(",\t");

                

                Serial.println(data);


                // For filtering: update of the value //
                  yk_1 = yk;
                  uk_1 = realvalLue;

                  yk_1_corr = yk_corr;
                  uk_1_corr = correctedValue;
                
                // Serial.print("Real value: "); Serial.println(realvalLue);
                // Serial.print("Displayed value: "); Serial.println(valLue);

                
              //     Displaying     //
              do {
                  u8g.setPrintPos(20, 15) ;
                  //u8g.print(correctedValue, 1);
                  u8g.print(yk, 1);
                  u8g.setPrintPos(15, 35) ;
                  u8g.print("grammes");
              } while(u8g.nextPage());
      break;
      
      default:
      break;
    } 
        
  }
